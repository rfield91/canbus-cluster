## main/Kconfig.projbuild
```kconfig
menu "Dash"

    choice DASH_MODE
        prompt "Run mode"
        default DASH_MODE_CAR
        help
            What the firmware does at power-on.

        config DASH_MODE_CAR
            bool "Car: poll the ECM over CAN and run the dash"
        config DASH_MODE_DEMO
            bool "Demo: simulated engine, CAN never starts"
            help
                For the bench. Native USB stays connected, because CAN and USB
                share GPIO19/20 and only CAN mode switches them over.
        config DASH_MODE_PID_SCAN
            bool "PID scan: sweep GM mode 22 on the ECM, no dash"
            help
                Asks the ECM for every mode 22 identifier in the range below
                and logs each answer. Read-only. See can/pid_scan.h.
    endchoice

    config DASH_DEMO_EXERCISE_WARNINGS
        bool "Demo: walk each tile past its warning limit in turn"
        depends on DASH_MODE_DEMO
        default y
        help
            So the warning flashes and the full-screen alert can be checked on
            the bench. Off, the demo only ever shows healthy values.

    config DASH_OBD_DEBUG
        bool "Log every OBD reply"
        default n
        help
            Logs each poll answer (PID, raw bytes, decoded value) and every
            negative response. For working out what the ECM supports.

    config DASH_PID_SCAN_FIRST
        hex "PID scan: first identifier"
        range 0x0000 0xFFFF
        default 0x0000

    config DASH_PID_SCAN_LAST
        hex "PID scan: last identifier"
        range 0x0000 0xFFFF
        default 0x2FFF

endmenu
```
